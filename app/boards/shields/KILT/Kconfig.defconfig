## app/boards/shields/KILT/Kconfig.defconfig
```kconfig
if KILT_LEFT

config ZMK_KEYBOARD_NAME
    default "K.I.L.T."

config ZMK_SPLIT_ROLE_CENTRAL
    default y

endif

if KILT_LEFT || KILT_RIGHT

config ZMK_SPLIT
    default y

endif
```

## app/boards/shields/KILT/Kconfig.shield
```kconfig
config KILT_LEFT
    def_bool $(shields_list_contains,kilt_left)

config KILT_RIGHT
    def_bool $(shields_list_contains,kilt_right)
```
